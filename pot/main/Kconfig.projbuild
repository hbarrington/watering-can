## pot/main/Kconfig.projbuild
```kconfig
menu "Watering Can Pot Module Configuration"

    config WC_POT_MOISTURE_ADC_GPIO
        int "Soil moisture sensor ADC GPIO"
        range 0 54
        default 19
        help
            GPIO wired to the capacitive soil moisture sensor's analog
            output, via the Hat2-Bus header. Must be an ADC-capable pin --
            on esp32p4, that's GPIO 16-23 (ADC1) or 49-54 (ADC2). GPIO19 on
            the Hat2-Bus header is now confirmed correct on real hardware
            (a first wiring attempt landed on GND/3.3V instead -- misread
            silkscreen -- and was caught by a pegged, out-of-range reading;
            after fixing the wiring, readings correctly track wet vs. dry).
            Other Hat2-Bus pins earmarked for future sensors are still
            unconfirmed -- verify with a multimeter/continuity test before
            trusting the silkscreen for those.

    config WC_POT_MOISTURE_RAW_DRY
        int "ADC raw reading calibrated as 0% (driest)"
        range 0 4095
        default 2800
        help
            Raw ADC counts measured with the sensor in open air -- the
            driest calibration point. Measured on hardware: ~2780-2834
            across several seconds of readings. Air (rather than bone-dry
            soil) is the standard "dry" calibration point for capacitive
            moisture sensors -- the sensor can't distinguish "no medium"
            from "bone-dry medium" since both have near-identical
            dielectric properties. If a real dry-soil reading ever falls
            outside the dry/wet range here, re-measure and adjust.

    config WC_POT_MOISTURE_RAW_WET
        int "ADC raw reading calibrated as 100% (wettest)"
        range 0 4095
        default 1478
        help
            Raw ADC counts measured with the sensor fully submerged in
            water -- the wettest calibration point. Measured on hardware:
            ~1461-1495 across several seconds of readings. For reference,
            moist (but not submerged) potting soil measured ~2000-2024 on
            this same sensor, landing comfortably between the two bounds
            here.

endmenu
```

## src/main/Kconfig.projbuild
```kconfig
menu "Watering Can Configuration"

    config WC_TIMEZONE
        string "POSIX TZ string"
        default "EST5EDT,M3.2.0/2,M11.1.0"
        help
            Passed to setenv("TZ", ...) so the schedule below is evaluated in
            local time rather than UTC.

    menu "Grow Light Relays"

        config WC_NUM_LIGHT_RELAYS
            int "Number of grow light relays in use"
            range 1 4
            default 2
            help
                How many of the 4 configured relay GPIOs below are actually
                wired up and should be driven. Lets us start with 2 relays
                and grow to 4 without code changes.

        config WC_RELAY_ACTIVE_LOW
            bool "Relays are active-low"
            default y
            help
                Confirmed on the LAFVIN dual-relay module: driving the pin
                LOW energizes the relay (COM -> NO). Driving it HIGH (or
                leaving it floating at boot) de-energizes it. See
                samples/relay-demo's README "Learnings" section.

        config WC_LIGHT_RELAY1_GPIO
            int "Relay 1 GPIO"
            default 25
            help
                Confirmed via voltmeter to match the board's "D25" silkscreen
                label directly (no off-by-one on this board).

        config WC_LIGHT_RELAY2_GPIO
            int "Relay 2 GPIO"
            default 26

        config WC_LIGHT_RELAY3_GPIO
            int "Relay 3 GPIO"
            default 27
            help
                Only used when "Number of grow light relays in use" is 3 or 4.

        config WC_LIGHT_RELAY4_GPIO
            int "Relay 4 GPIO"
            default 33
            help
                Only used when "Number of grow light relays in use" is 4.

        config WC_LIGHT_ON_HOUR
            int "Lights ON hour (0-23, local time)"
            range 0 23
            default 4
            help
                4am-2pm is the current schedule for the calamansi trees.

        config WC_LIGHT_ON_MINUTE
            int "Lights ON minute"
            range 0 59
            default 0

        config WC_LIGHT_OFF_HOUR
            int "Lights OFF hour (0-23, local time)"
            range 0 23
            default 14

        config WC_LIGHT_OFF_MINUTE
            int "Lights OFF minute"
            range 0 59
            default 0

    endmenu

    menu "Web API"

        config WC_HTTP_PORT
            int "HTTP API port"
            range 1 65535
            default 80
            help
                Port for the status/schedule/override/ota web API (see
                web_api component). No authentication -- same LAN-trust
                model as the rest of this project.

    endmenu

endmenu
```
